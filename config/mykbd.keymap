/ {
    chosen {
        zmk,kscan = &kscan0;
    };

    kscan0: kscan {
        compatible = "zmk,kscan-gpio-matrix";

        row-gpios = <&gpio0 9 GPIO_ACTIVE_HIGH>,
                    <&gpio0 10 GPIO_ACTIVE_HIGH>;

        col-gpios = <&gpio1 6 GPIO_ACTIVE_HIGH>,
                    <&gpio1 4 GPIO_ACTIVE_HIGH>,
                    <&gpio0 11 GPIO_ACTIVE_HIGH>;

        diode-direction = "row2col";
    };
};